## config/boards/shields/iurii/Kconfig.defconfig
```kconfig
if SHIELD_IURII_LEFT

config ZMK_KEYBOARD_NAME
    default "Iurii"

config ZMK_SPLIT_ROLE_CENTRAL
    default y

endif

if SHIELD_IURII_RIGHT

config ZMK_KEYBOARD_NAME
    default "Iurii"

endif

if SHIELD_IURII_LEFT || SHIELD_IURII_RIGHT

config ZMK_SPLIT
    default y

endif
```

## config/boards/shields/iurii/Kconfig.shield
```kconfig
config SHIELD_IURII_LEFT
    def_bool $(shields_list_contains,iurii_left)

config SHIELD_IURII_RIGHT
    def_bool $(shields_list_contains,iurii_right)
```

## config/boards/shields/iurii_test_right/Kconfig.defconfig
```kconfig
if SHIELD_IURII_TEST_RIGHT

config ZMK_KEYBOARD_NAME
    default "IuriiRight"

endif
```

## config/boards/shields/iurii_test_right/Kconfig.shield
```kconfig
config SHIELD_IURII_TEST_RIGHT
    def_bool $(shields_list_contains,iurii_test_right)
```
