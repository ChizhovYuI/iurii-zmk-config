#include "iurii.dtsi"

&kscan0 {
    col-gpios
        = <&gpio0 2  GPIO_ACTIVE_HIGH>  // D0 = col0
        , <&gpio0 3  GPIO_ACTIVE_HIGH>  // D1 = col1
        , <&gpio0 4  GPIO_ACTIVE_HIGH>  // D4 = col2
        , <&gpio0 5  GPIO_ACTIVE_HIGH>  // D5 = col3
        , <&gpio1 11 GPIO_ACTIVE_HIGH>  // D6 = col4
        ;

    row-gpios
        = <&gpio1 15 (GPIO_ACTIVE_HIGH | GPIO_PULL_DOWN)>  // D10 = row0
        , <&gpio1 14 (GPIO_ACTIVE_HIGH | GPIO_PULL_DOWN)>  // D9 = row1
        , <&gpio1 13 (GPIO_ACTIVE_HIGH | GPIO_PULL_DOWN)>  // D8 = row2
        , <&gpio1 12 (GPIO_ACTIVE_HIGH | GPIO_PULL_DOWN)>  // D7 = row3
        ;
};
