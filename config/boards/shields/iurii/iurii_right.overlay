#include "iurii.dtsi"

&default_transform {
    col-offset = <5>;
};

&kscan0 {
    col-gpios
        = <&gpio0 2  GPIO_ACTIVE_HIGH>  // D0 = col0 (→ col5 with offset)
        , <&gpio0 3  GPIO_ACTIVE_HIGH>  // D1 = col1 (→ col6 with offset)
        , <&gpio0 4  GPIO_ACTIVE_HIGH>  // D4 = col2 (→ col7 with offset)
        , <&gpio0 5  GPIO_ACTIVE_HIGH>  // D5 = col3 (→ col8 with offset)
        , <&gpio1 11 GPIO_ACTIVE_HIGH>  // D6 = col4 (→ col9 with offset)
        ;
};
